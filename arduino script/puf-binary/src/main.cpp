#include "Arduino.h"
#include <stdio.h>
#include <Tools.h>
#include <BCH.h>
#include <SPI.h>

#define RDSR        5
#define WRSR        1
#define READ        3
#define WRITE       2

byte cs_pin = 10; //cs_pin location of the two SRAMS
uint32_t maxpage = 4096;  //number of pages in 23LC1024 SRAM
uint32_t i, j, n;
uint32_t value;
uint32_t num = 0;
uint32_t total_send = 10;
// uint8_t buff[32];
uint32_t index = 0;
uint8_t key_256[] = {0xd2, 0xf, 0x56, 0x56, 0xbf, 0x43, 0x65, 0x16, 0xcd, 0xf, 0x3d, 0x2e, 0x73, 0x48, 0x51, 0xdc,
                         0x53, 0x7d, 0xf5, 0x18, 0x97, 0x48, 0x41, 0x28, 0xcc, 0xae, 0x67, 0xee, 0x13, 0x10, 0xf6,
                         0x9b,};
long puf_index_default[] = {52888, 52920, 53136, 53168, 53384, 53416, 53632, 53664, 75864, 76112, 76360, 76608, 22648, 22896, 23144, 23392, 52952, 53200, 53448, 53696, 22584,
  23080, 23328, 11544, 11792, 12040, 12288, 22616, 22864, 23112, 23360, 33240, 33488, 33736, 33984, 115800, };
  uint8_t puf_binary_default[37*8] = {
    0x0, 0xFB, 0xFB, 0xFB, 0xFB, 0xFB, 0xFB, 0xFB, 0x62, 0x62, 0x62, 0x62, 0x62, 0x62, 0x62, 0x62, 0xBB, 0xBB, 0xBB, 0xBB, 0xBB, 0xBB, 0xBB, 0xBB,
                    0x35, 0x35, 0x35, 0x35, 0x35, 0x35, 0x35, 0x35, 0x5, 0x5, 0x5, 0x5, 0x5, 0x5, 0x5, 0x5, 0x10, 0x10, 0x10, 0x10, 0x10, 0x10, 0x10, 0x10,
                    0x87, 0x87, 0x87, 0x87, 0x87, 0x87, 0x87, 0x87, 0xD5, 0xD5, 0xD5, 0xD5, 0xD5, 0xD5, 0xD5, 0xD5, 0x40, 0x40, 0x40, 0x40, 0x40, 0x40, 0x40, 0x40,
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                    0xE0, 0xE0, 0xE0, 0xE0, 0xE0, 0xE0, 0xE0, 0xE0,
    };
uint8_t helper_data[] = {
  0x13, 0xd1, 0xfc, 0x25, 0x8e, 0x7e, 0x3d,
0x8d, 0x58, 0xa0, 0x81, 0xb, 0x71, 0x48,
0x47, 0xab, 0x7e, 0x86, 0xa7, 0x2d, 0x57,
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0xbc, 0x8d, 0xc2, 0x85, 0xa0, 0x1b, 0x2e,
};

uint8_t puf_binary_new[8*37];
int inByte;

int pin_hold = 11;
int pin_select = 10;
int pin_mosfet = 12;
int pin_power = 8;

void print_binary(uint8_t v)
{
    int num_places = 8;
    int mask=0, n;

    for (n=1; n<=num_places; n++)
    {
        mask = (mask << 1) | 0x0001;
    }
    v = v & mask;  // truncate v to specified number of places

    while(num_places)
    {
        if (v & (0x0001 << num_places-1))
        {
             Serial.print("1");
        }
        else
        {
             Serial.print("0");
        }

        --num_places;
        Serial.print(", ");
    }
}

uint8_t Spi23LC1024Read8(uint32_t address, uint8_t cs_pin)
{
  uint8_t read_byte;

  digitalWrite(cs_pin, LOW);
  SPI.transfer(READ);
  SPI.transfer((uint8_t)(address >> 16));
  SPI.transfer((uint8_t)(address >> 8) & 0xFF);
  SPI.transfer((uint8_t)address);
  read_byte = SPI.transfer(0x00);
  digitalWrite(cs_pin, HIGH);

  return read_byte;
}

void readSRAM(){
  uint8_t result;

  SPI.begin();
  digitalWrite(pin_select, LOW);
  digitalWrite(pin_hold, HIGH);
  digitalWrite(pin_mosfet, HIGH);
  digitalWrite(pin_power, HIGH);
  delay(100);

  // read
  index = 0;
  for (i = 0; i < 37; i++)
  {
    for (j = 0; j < 8; j++){
      result = Spi23LC1024Read8(puf_index_default[i], cs_pin);
      puf_binary_new[index] = result;
      // Serial.print("0x");
      // Serial.print(puf_binary_new[index], HEX);
      // Serial.print(",");
      // Serial.print("0x");
      // Serial.print(puf_binary_default[index], HEX);
      // Serial.print(" - ");
      index++;
      // Serial.println();
    }
    // if ((i+1)%3==0)
    //   Serial.println();
  }


  digitalWrite(pin_select, HIGH);
  //  digitalWrite(pin_hold, LOW);
  digitalWrite(pin_hold, HIGH);
  digitalWrite(pin_mosfet, LOW);
  digitalWrite(pin_power, LOW);

  SPI.end();
}

int difference_bin_array(uint8_t a[], uint8_t b[], int size) {
    int count = 0;
    int index = 0;
    int shift = 0;
    for (int i = 0; i < size; i++) {
        shift = (7 - (i % 8));
        // Serial.print((a[index] >> shift) & 0x1);
        // Serial.print((b[index] >> shift) & 0x1);
        // Serial.print(" ");
        if (((a[index] >> shift) & 0x1) != ((b[index] >> shift) & 0x1)) {
            count++;
        }
        if ((i + 1) % 8 == 0)
            index++;
    }
    // Serial.println();
    return count;
}

void check_difference(){
  Serial.println();
  int max_diff = 0;
  int max_idx = 0;
  int diff=0;
  for (i=0;i<37;i++){
    // Serial.print(i);
    // Serial.print(" - ");
    diff = 0;
    for (j =0;j<8;j++){
      diff += difference_bin_array(&puf_binary_new[i], &puf_binary_default[i], 8);
      // Serial.print(diff);
      // Serial.println(", ");
      // Serial.print((int) &puf_binary_new[i], HEX);
      // Serial.print(", ");
      // Serial.print((int) &puf_binary_default[i], HEX);
      // Serial.println();
      if (diff > max_diff){
        max_diff = diff;
        max_idx = i;
      }
    }
    // Serial.print(diff);
  }
  Serial.print("Max difference: ");
  Serial.println(max_diff);
  Serial.print("Max index: ");
  Serial.println(max_idx);
}

void set(){
  Serial.begin(9600);

  delay(1000);

  pinMode(LED_BUILTIN, OUTPUT);

  pinMode(pin_select, OUTPUT);
  pinMode(pin_hold, OUTPUT);
  pinMode(pin_mosfet, OUTPUT);
  pinMode(pin_power, OUTPUT);
}

uint8_t encoded_new[8*37];
uint8_t xor_enroll_new[8*37];
uint8_t helper_data_new[7*37];
uint8_t helper_data_padded_new[8*37];
uint8_t xor_reproduction_new[8*37];
uint8_t reconstructed_key_new[37];
uint8_t key_per_row[37];

BCH bch;
Tools tools;

void decode(){
  memset(helper_data_padded_new, 0, sizeof(helper_data_padded_new));
  memset(xor_reproduction_new, 0, sizeof(xor_reproduction_new));
  memset(reconstructed_key_new, 0, sizeof(reconstructed_key_new));
  memset(key_per_row, 0, sizeof(key_per_row));

  int row = 37;
  int n = bch.get_n();
  int k = bch.get_key_length();

  int k_length_bit = row;//tools.ceil(k*row,8);
  int n_length_bit = row * 8;//tools.ceil(n*row,8);

  /************************************
   ****** REPRODUCTION PROCEDURE ******
   ************************************/
  /******************** ASSERT HELPER DATA PADDED**********************/
  Serial.println("HELPER DATA PADDED");
  for (i = 0; i < row; i++) {
      memcpy(&helper_data_padded_new[i * 8], &helper_data[i * 7],
             7 * sizeof(uint8_t));
  }

  /******************** ASSERT XOR REPRODUCTION **********************/
  Serial.println("XOR REPRODUCTION");
  for (i = 0; i < row; i++) {
     for (j = 0; j < 8; j++) {
       // xor_reproduction_new[i*8 + j] = puf_binary_new[i*8 + j] ^ helper_data_padded_new[i*8 + j];
       xor_reproduction_new[i*8 + j] = puf_binary_default[i*8 + j] ^ helper_data_padded_new[i*8 + j];
     }
  }

  /******************** ASSERT RECONSTRUCTED KEY **********************/
  Serial.println("RECONSTRUCTED KEY");
  int8_t input[64];
  for (i = 0; i < row; i++) {
      memset(input, 0, sizeof(input));
      tools.convert_uint8_array_to_bin_array(&xor_reproduction_new[i*8], input, 8);
    // bch.decode_bch(&xor_reproduction_new[i * 8], &reconstructed_key_new[i]);
      bch.decode_bch_old(input, &reconstructed_key_new[i]);
      // tools.print_binary(reconstructed_key_new[i]);
      // Serial.println();
  }

  tools.gen_key_per_row(key_256, key_per_row);

  for (i = 0; i < row; i++) {
    Serial.print(i);
    Serial.print(" - ");
    tools.print_binary(key_per_row[i]);
    Serial.print(" ");
    tools.print_binary(reconstructed_key_new[i]);
    if (key_per_row[i] == reconstructed_key_new[i]){
      Serial.println(" TRUE");
    }else{
      Serial.println(" FALSE");
    }
  }
}

void setup(void)
{
  set();

  Serial.println("READ");

  readSRAM();
  check_difference();

  Serial.println("START PUF DECODE");

  bch = BCH();
  tools = Tools();
  bch.initialize();               /* Read m */

  decode();
}



void loop(){

}
